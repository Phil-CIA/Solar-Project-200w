/* Rev 1 stage: deterministic WS2812 heartbeat on D8->D11 chain via PB2. */

#include <stdint.h>

#define REG32(address) (*(volatile uint32_t *)(address))

#define RCC_BASE 0x40021000UL
#define RCC_AHB2ENR REG32(RCC_BASE + 0x4CUL)
#define GPIOB_BASE 0x48000400UL

#define GPIO_MODER(base) REG32((base) + 0x00UL)
#define GPIO_OTYPER(base) REG32((base) + 0x04UL)
#define GPIO_BSRR(base) REG32((base) + 0x18UL)

#define GPIOB_EN_BIT (1UL << 1)
#define PB2_BIT (1UL << 2)
#define PB2_SET PB2_BIT
#define PB2_CLR (PB2_BIT << 16U)

/*
 * Startup clock remains HSI16 in this stage (SystemInit is the default no-op).
 * Timing is generated by deterministic NOP windows and instruction-path symmetry.
 */
#define CPU_HZ 16000000UL
#define CYCLES_PER_US 16UL
#define WS_RESET_CYCLES (300UL * CYCLES_PER_US) /* 300 us reset/latch low */

static void delay_cycles(volatile uint32_t cycles) {
    while (cycles-- > 0U) {
        __asm volatile("nop");
    }
}

static inline void ws_delay_short(void) {
    __asm volatile(
        "nop\n\t"
        "nop\n\t"
        "nop\n\t"
        "nop\n\t"
        "nop\n\t"
        :
        :
        : "memory");
}

static inline void ws_delay_long(void) {
    __asm volatile(
        "nop\n\t"
        "nop\n\t"
        "nop\n\t"
        "nop\n\t"
        "nop\n\t"
        "nop\n\t"
        "nop\n\t"
        "nop\n\t"
        "nop\n\t"
        "nop\n\t"
        "nop\n\t"
        :
        :
        : "memory");
}

static inline void ws_send_bit0(void) {
    GPIO_BSRR(GPIOB_BASE) = PB2_SET;
    ws_delay_short();
    GPIO_BSRR(GPIOB_BASE) = PB2_CLR;
    ws_delay_long();
}

static inline void ws_send_bit1(void) {
    GPIO_BSRR(GPIOB_BASE) = PB2_SET;
    ws_delay_long();
    GPIO_BSRR(GPIOB_BASE) = PB2_CLR;
    ws_delay_short();
}

static void ws_send_byte(uint8_t value) {
    for (uint8_t mask = 0x80U; mask != 0U; mask >>= 1U) {
        if ((value & mask) != 0U) {
            ws_send_bit1();
        } else {
            ws_send_bit0();
        }
    }
}

static void ws_send_pixel(uint8_t red, uint8_t green, uint8_t blue) {
    ws_send_byte(green);
    ws_send_byte(red);
    ws_send_byte(blue);
}

static void ws_latch_reset(void) {
    GPIO_BSRR(GPIOB_BASE) = PB2_CLR;
    delay_cycles(WS_RESET_CYCLES);
}

static void pb2_init(void) {
    RCC_AHB2ENR |= GPIOB_EN_BIT;
    (void)RCC_AHB2ENR;

    GPIO_OTYPER(GPIOB_BASE) &= ~PB2_BIT;
    GPIO_MODER(GPIOB_BASE) = (GPIO_MODER(GPIOB_BASE) & ~(3UL << (2U * 2U))) | (1UL << (2U * 2U));
    GPIO_BSRR(GPIOB_BASE) = PB2_CLR;
}

static void ws_send_two_pixels(uint8_t d8_red, uint8_t d8_green, uint8_t d8_blue,
                               uint8_t d11_red, uint8_t d11_green, uint8_t d11_blue) {
    ws_send_pixel(d8_red, d8_green, d8_blue);
    ws_send_pixel(d11_red, d11_green, d11_blue);
    ws_latch_reset();
}

int main(void) {
    pb2_init();
    ws_latch_reset();

    for (;;) {
        ws_send_two_pixels(
            0x08U, 0x00U, 0x00U, /* D8: dim red */
            0x08U, 0x00U, 0x00U  /* D11: dim red */
        );
        delay_cycles(CPU_HZ / 4U);     /* ~250 ms on-time */

        ws_send_two_pixels(
            0x00U, 0x00U, 0x00U, /* D8 off */
            0x00U, 0x00U, 0x00U  /* D11 off */
        );
        delay_cycles(CPU_HZ);          /* ~1 s off-time */
    }
}
